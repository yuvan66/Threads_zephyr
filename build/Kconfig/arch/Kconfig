## build/Kconfig/arch/Kconfig
```kconfig
# Load Zephyr Arch Kconfig descriptions.
osource "/home/yuvan66/zephyrproject/zephyr/arch/rx/Kconfig"
osource "/home/yuvan66/zephyrproject/zephyr/arch/x86/Kconfig"
osource "/home/yuvan66/zephyrproject/zephyr/arch/xtensa/Kconfig"
osource "/home/yuvan66/zephyrproject/zephyr/arch/sparc/Kconfig"
osource "/home/yuvan66/zephyrproject/zephyr/arch/riscv/Kconfig"
osource "/home/yuvan66/zephyrproject/zephyr/arch/posix/Kconfig"
osource "/home/yuvan66/zephyrproject/zephyr/arch/openrisc/Kconfig"
osource "/home/yuvan66/zephyrproject/zephyr/arch/mips/Kconfig"
osource "/home/yuvan66/zephyrproject/zephyr/arch/arm64/Kconfig"
osource "/home/yuvan66/zephyrproject/zephyr/arch/arm/Kconfig"
osource "/home/yuvan66/zephyrproject/zephyr/arch/arc/Kconfig"
```

## build/Kconfig/boards/Kconfig.defconfig
```kconfig
# Load Zephyr board defconfig descriptions.
osource "/home/yuvan66/zephyrproject/zephyr/boards/espressif/esp32_devkitc/Kconfig.defconfig"
```

## build/Kconfig/boards/Kconfig.esp32_devkitc
```kconfig
# Load board Kconfig descriptions.
osource "/home/yuvan66/zephyrproject/zephyr/boards/espressif/esp32_devkitc/Kconfig.esp32_devkitc"
```
